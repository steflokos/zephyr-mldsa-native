## zephyr/Kconfig
```kconfig
menuconfig MLDSA_NATIVE
    bool "ML-DSA Native Library"
    default y
    help
      Enable the mldsa-native library (Dilithium).

if MLDSA_NATIVE

choice
    prompt "Security Level"
    default MLDSA_LEVEL_87
    help
      Select the ML-DSA security level.

config MLDSA_LEVEL_44
    bool "ML-DSA-44 (NIST Level 2)"

config MLDSA_LEVEL_65
    bool "ML-DSA-65 (NIST Level 3)"

config MLDSA_LEVEL_87
    bool "ML-DSA-87 (NIST Level 5)"

endchoice

endif # MLDSA_NATIVE
```
